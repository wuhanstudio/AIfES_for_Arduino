## CMakeLists.txt
```
cmake_minimum_required(VERSION 3.20.0)

find_package(Zephyr REQUIRED HINTS $ENV{ZEPHYR_BASE})
project(aifes_xor_inference)

set (AIfES_ROOT_DIR ${CMAKE_CURRENT_SOURCE_DIR}/../../../src)

zephyr_compile_options(
    -Wall
    -Wextra
    -Wno-pedantic
    -Wno-unused-parameter
    -Wno-maybe-uninitialized
    -Wno-sign-compare
    -Wno-missing-field-initializers
    -Wno-absolute-value
    -Wno-pointer-arith
    -Wno-double-promotion
)

target_compile_definitions(app
    PRIVATE AIDEBUG_ENABLE_PRINTING
)

target_include_directories(app PUBLIC
    ${CMAKE_CURRENT_SOURCE_DIR}
    ${AIfES_ROOT_DIR}
    ${AIfES_ROOT_DIR}/core
    ${AIfES_ROOT_DIR}/basic/base
    ${AIfES_ROOT_DIR}/basic/default
    ${AIfES_ROOT_DIR}/basic/express
)

file(GLOB app_sources 
    src/* 
    ${AIfES_ROOT_DIR}/*
    ${AIfES_ROOT_DIR}/basic/base/aialgo/*
    ${AIfES_ROOT_DIR}/basic/base/ailayer/*
    ${AIfES_ROOT_DIR}/basic/base/ailoss/* 
    ${AIfES_ROOT_DIR}/basic/base/aimath/* 
    ${AIfES_ROOT_DIR}/basic/base/aiopti/* 
    ${AIfES_ROOT_DIR}/basic/default/ailayer/*
    ${AIfES_ROOT_DIR}/basic/default/ailoss/*
    ${AIfES_ROOT_DIR}/basic/default/aimath/*
    ${AIfES_ROOT_DIR}/basic/default/aiopti/*
    ${AIfES_ROOT_DIR}/basic/express/*)

target_sources(app PRIVATE ${app_sources})
```

## prj.conf
```kconfig
CONFIG_MAIN_STACK_SIZE=2048

CONFIG_REQUIRES_FLOAT_PRINTF=y
CONFIG_HW_STACK_PROTECTION=y

CONFIG_GPIO=y
CONFIG_LOG=y

CONFIG_SHELL=y
CONFIG_CONSOLE=y
CONFIG_UART_CONSOLE=y

CONFIG_FILE_SYSTEM=y
CONFIG_FILE_SYSTEM_MKFS=y
CONFIG_FAT_FILESYSTEM_ELM=y
CONFIG_FS_FATFS_LFN=y

CONFIG_ZVFS_OPEN_MAX=16
CONFIG_FS_FATFS_NUM_FILES=16
CONFIG_FILE_SYSTEM_SHELL=y
CONFIG_FILE_SYSTEM_SHELL_LS_SIZE=y

CONFIG_POSIX_API=y
CONFIG_NEWLIB_LIBC=y
CONFIG_DISK_ACCESS=y

# CONFIG_ENTROPY_GENERATOR=y
# CONFIG_CSPRNG_NEEDED=y
# CONFIG_TEST_RANDOM_GENERATOR=y

# CONFIG_HEAP_MEM_POOL_SIZE=20480
```

## src/main.c
```c
#include <stdio.h>
#include <stdlib.h>

#include "aifes.h"

int main(void)
{
    printf("AIfES XOR inference demo (Zephyr)\n");

    //
    // Input tensor
    //
    float input_data[] = {0.0f, 1.0f};
    uint16_t input_shape[] = {1, 2};

    aitensor_t input_tensor =
        AITENSOR_2D_F32(input_shape, input_data);

    //
    // Input layer
    //
    uint16_t input_layer_shape[] = {1, 2};

    ailayer_input_f32_t input_layer =
        AILAYER_INPUT_F32_M(
            2,
            input_layer_shape);

    //
    // Dense layer 1
    //
    float weights_data_dense_1[] = {
        -10.1164f, -8.4212f,
         5.4396f,  7.2970f,
        -7.6482f, -9.0155f
    };

    float bias_data_dense_1[] = {
        -2.9653f,
         2.3677f,
        -1.5968f
    };

    ailayer_dense_f32_t dense_layer_1 =
        AILAYER_DENSE_F32_M(
            3,
            weights_data_dense_1,
            bias_data_dense_1);

    //
    // Sigmoid 1
    //
    ailayer_sigmoid_f32_t sigmoid_layer_1 =
        AILAYER_SIGMOID_F32_M();

    //
    // Dense layer 2
    //
    float weights_data_dense_2[] = {
        12.0305f,
        -6.5858f,
        11.9371f
    };

    float bias_data_dense_2[] = {
        -5.4247f
    };

    ailayer_dense_f32_t dense_layer_2 =
        AILAYER_DENSE_F32_M(
            1,
            weights_data_dense_2,
            bias_data_dense_2);

    //
    // Sigmoid 2
    //
    ailayer_sigmoid_f32_t sigmoid_layer_2 =
        AILAYER_SIGMOID_F32_M();

    //
    // Model definition
    //
    aimodel_t model;
    ailayer_t *x;

    model.input_layer =
        ailayer_input_f32_default(&input_layer);

    x = ailayer_dense_f32_default(
        &dense_layer_1,
        model.input_layer);

    x = ailayer_sigmoid_f32_default(
        &sigmoid_layer_1,
        x);

    x = ailayer_dense_f32_default(
        &dense_layer_2,
        x);

    model.output_layer =
        ailayer_sigmoid_f32_default(
            &sigmoid_layer_2,
            x);

    //
    // Compile model
    //
    aialgo_compile_model(&model);

    //
    // Print structure
    //
    printf("\nModel structure:\n");
    aialgo_print_model_structure(&model);

    //
    // Allocate inference memory
    //
    uint32_t memory_size =
        aialgo_sizeof_inference_memory(&model);

    printf("\nInference memory: %u bytes\n", memory_size);

    uint8_t *memory_ptr =
        (uint8_t *)malloc(memory_size);

    if (memory_ptr == NULL)
    {
        printf("Memory allocation failed\n");
        return 1;
    }

    aialgo_schedule_inference_memory(
        &model,
        memory_ptr,
        memory_size);

    //
    // Output tensor
    //
    uint16_t output_shape[] = {1, 1};
    float output_data[1];

    aitensor_t output_tensor =
        AITENSOR_2D_F32(output_shape, output_data);

    //
    // Run inference
    //
    aialgo_inference_model(
        &model,
        &input_tensor,
        &output_tensor);

    //
    // Print result
    //
    printf("\nResults:\n");
    printf("Input 1: %f\n", input_data[0]);
    printf("Input 2: %f\n", input_data[1]);
    printf("Output  : %f\n", ((float *)output_tensor.data)[0]);

    free(memory_ptr);

    return 0;
}
```
